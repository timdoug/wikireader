## linux/buildroot/external/Config.in
```kconfig
source "$BR2_EXTERNAL_WIKIREADER_PATH/package/wikireader-system/Config.in"
source "$BR2_EXTERNAL_WIKIREADER_PATH/package/wr-console/Config.in"
source "$BR2_EXTERNAL_WIKIREADER_PATH/package/wr-xterm/Config.in"
source "$BR2_EXTERNAL_WIKIREADER_PATH/package/wr-xorg/Config.in"
source "$BR2_EXTERNAL_WIKIREADER_PATH/package/wr-wayland/Config.in"
source "$BR2_EXTERNAL_WIKIREADER_PATH/package/wr-wlkeyboard/Config.in"
```

## linux/buildroot/external/package/wikireader-system/Config.in
```kconfig
config BR2_PACKAGE_WIKIREADER_SYSTEM
	bool "wikireader-system"
	depends on BR2_c33
	depends on BR2_PACKAGE_BUSYBOX
	help
	  The WikiReader's init configuration (inittab, fstabs, rcS) and
	  the self-tests rcS runs under wr.selftest: freestanding
	  diagnostic programs, the uClibc program they run, and the
	  BusyBox suite.
```

## linux/buildroot/external/package/wr-console/Config.in
```kconfig
config BR2_PACKAGE_WR_CONSOLE
	bool "wr-console"
	depends on BR2_c33
	help
	  The WikiReader's userspace terminal, wr-console, which draws a
	  shell's PTY on the framebuffer and types into it from every
	  keyboard; and its touchscreen keyboard, wr-keyboard, a uinput
	  device drawn below the text, which also blanks and suspends the
	  idle machine.
```

## linux/buildroot/external/package/wr-wayland/Config.in
```kconfig
config BR2_PACKAGE_WR_WAYLAND
	bool "WikiReader Wayland session"
	depends on BR2_PACKAGE_CAGE
	depends on BR2_PACKAGE_FOOT
	depends on BR2_PACKAGE_XORG7 # xkeyboard-config
	select BR2_PACKAGE_XKEYBOARD_CONFIG
	select BR2_PACKAGE_WR_WLKEYBOARD
	help
	  startw, which runs foot (or another client) under cage on a VT
	  of its own with wlkeyboard below it; X's misc-fixed 6x13, the
	  font it uses; and a US keymap for libxkbcommon.
```

## linux/buildroot/external/package/wr-wlkeyboard/Config.in
```kconfig
config BR2_PACKAGE_WR_WLKEYBOARD
	bool "wlkeyboard"
	depends on BR2_PACKAGE_WAYLAND
	select BR2_PACKAGE_LIBXKBCOMMON
	select BR2_PACKAGE_WAYLAND_PROTOCOLS
	help
	  The console's soft keyboard for Wayland compositors with the
	  layer shell and virtual keyboards, such as cage.
```

## linux/buildroot/external/package/wr-xorg/Config.in
```kconfig
config BR2_PACKAGE_WR_XORG
	bool "WikiReader X session"
	depends on BR2_PACKAGE_XSERVER_XORG_SERVER_MODULAR
	depends on !BR2_STATIC_LIBS # libudev-zero
	select BR2_PACKAGE_LIBUDEV_ZERO
	select BR2_PACKAGE_XDRIVER_XF86_INPUT_LIBINPUT
	select BR2_PACKAGE_XKEYBOARD_CONFIG
	help
	  X on the panel: Xorg through the modesetting driver on DRM at
	  one bit a pixel, with the touch screen and buttons through
	  libinput, and
	  startx, which runs twm, xeyes and an xterm with the on-screen
	  keyboard.  The keymap is compiled when this is built.
```

## linux/buildroot/external/package/wr-xterm/Config.in
```kconfig
config BR2_PACKAGE_WR_XTERM
	bool "WikiReader xterm launcher"
	depends on BR2_PACKAGE_XORG7
	select BR2_PACKAGE_XTERM
	help
	  Run xterm with a real PTY and a separately spawned shell on NOMMU.
```

## linux/buildroot/external/package/xserver-kdrive/Config.in
```kconfig
config BR2_PACKAGE_XSERVER_KDRIVE
	bool "xserver-kdrive (Xfbdev)"
	depends on BR2_PACKAGE_XORG7
	depends on BR2_TOOLCHAIN_HAS_THREADS
	select BR2_PACKAGE_LIBSHA1
	select BR2_PACKAGE_PIXMAN
	select BR2_PACKAGE_XKEYBOARD_CONFIG
	select BR2_PACKAGE_XLIB_LIBXAU
	select BR2_PACKAGE_XLIB_LIBXFONT2
	select BR2_PACKAGE_XLIB_LIBXKBFILE
	select BR2_PACKAGE_XLIB_XTRANS
	select BR2_PACKAGE_XORGPROTO
	help
	  Xfbdev, the kdrive X server that draws on a Linux framebuffer
	  and reads evdev devices, from xorg-server 1.19, the last
	  release that has it.  Its keymap is compiled when it is built,
	  and it draws the WikiReader's one-bit panel through a shadow.
```

## linux/overlay/Documentation/devicetree/bindings/c33/epson.yaml
```yaml
# SPDX-License-Identifier: (GPL-2.0-only OR BSD-2-Clause)
%YAML 1.2
---
$id: http://devicetree.org/schemas/c33/epson.yaml#
$schema: http://devicetree.org/meta-schemas/core.yaml#

title: Boards with an Epson S1C33 processor

maintainers:
  - Tim Douglas <me@timdoug.com>

properties:
  $nodename:
    const: /
  compatible:
    oneOf:
      - description: The Openmoko WikiReader
        items:
          - const: openmoko,wikireader
          - const: epson,s1c33e07

additionalProperties: true
```

## linux/overlay/Documentation/devicetree/bindings/clock/epson,s1c33-cmu.yaml
```yaml
# SPDX-License-Identifier: (GPL-2.0-only OR BSD-2-Clause)
%YAML 1.2
---
$id: http://devicetree.org/schemas/clock/epson,s1c33-cmu.yaml#
$schema: http://devicetree.org/meta-schemas/core.yaml#

title: Epson S1C33E07 clock-management unit

maintainers:
  - Tim Douglas <me@timdoug.com>

description:
  MCLK, the system clock, from the high-speed oscillator divided, from the
  low-speed oscillator, or from the PLL on the high-speed one, and the
  peripherals' gates.  The clock numbers are in
  include/dt-bindings/clock/s1c33-cmu.h.

properties:
  compatible:
    const: epson,s1c33-cmu

  reg:
    maxItems: 1

  clocks:
    items:
      - description: The high-speed oscillator, OSC3
      - description: The low-speed oscillator, OSC1

  clock-names:
    items:
      - const: osc3
      - const: osc1

  '#clock-cells':
    const: 1

required:
  - compatible
  - reg
  - clocks
  - clock-names
  - '#clock-cells'

additionalProperties: false

examples:
  - |
    clock-controller@301b00 {
        compatible = "epson,s1c33-cmu";
        reg = <0x301b00 0x30>;
        clocks = <&osc3>, <&osc1>;
        clock-names = "osc3", "osc1";
        #clock-cells = <1>;
    };
```

## linux/overlay/Documentation/devicetree/bindings/display/epson,s1c33-lcdc.yaml
```yaml
# SPDX-License-Identifier: (GPL-2.0-only OR BSD-2-Clause)
%YAML 1.2
---
$id: http://devicetree.org/schemas/display/epson,s1c33-lcdc.yaml#
$schema: http://devicetree.org/meta-schemas/core.yaml#

title: Epson S1C33E07 LCD controller

maintainers:
  - Tim Douglas <me@timdoug.com>

description:
  The LCD controller scanning a one-bit-a-pixel image from internal video
  RAM or SDRAM onto a 4-bit monochrome panel interface.

properties:
  compatible:
    const: epson,s1c33-lcdc

  reg:
    items:
      - description: Internal video RAM, for the image the controller scans
      - description: The controller's registers

  reg-names:
    items:
      - const: vram
      - const: lcdc

  enable-gpios:
    maxItems: 1
    description: The panel's display-enable line

required:
  - compatible
  - reg
  - reg-names

unevaluatedProperties: false

examples:
  - |
    #include <dt-bindings/gpio/gpio.h>

    display-controller@80000 {
        compatible = "epson,s1c33-lcdc";
        reg = <0x080000 0x1a00>, <0x301a00 0x100>;
        reg-names = "vram", "lcdc";
        enable-gpios = <&pinctrl 24 GPIO_ACTIVE_HIGH>;
    };
```

## linux/overlay/Documentation/devicetree/bindings/display/epson,s1c33e07-lcdc.yaml
```yaml
# SPDX-License-Identifier: (GPL-2.0-only OR BSD-2-Clause)
%YAML 1.2
---
$id: http://devicetree.org/schemas/display/epson,s1c33e07-lcdc.yaml#
$schema: http://devicetree.org/meta-schemas/core.yaml#

title: Epson S1C33E07 LCD controller

maintainers:
  - Tim Douglas <me@timdoug.com>

description:
  The LCD controller scanning a one-bit-a-pixel image from internal video
  RAM or SDRAM onto a 4-bit monochrome panel interface.  Its images are
  framebuffers in SDRAM; the internal video RAM is not described here,
  since the platform may take it as general-purpose RAM.

properties:
  compatible:
    const: epson,s1c33e07-lcdc

  reg:
    items:
      - description: The controller's registers

  reg-names:
    items:
      - const: lcdc

  port:
    $ref: /schemas/graph.yaml#/properties/port
    description: The panel

required:
  - compatible
  - reg
  - reg-names
  - port

unevaluatedProperties: false

examples:
  - |
    display-controller@301a00 {
        compatible = "epson,s1c33e07-lcdc";
        reg = <0x301a00 0x100>;
        reg-names = "lcdc";

        port {
            endpoint {
                remote-endpoint = <&panel_in>;
            };
        };
    };
```

## linux/overlay/Documentation/devicetree/bindings/display/panel/openmoko,wikireader-lcd.yaml
```yaml
# SPDX-License-Identifier: (GPL-2.0-only OR BSD-2-Clause)
%YAML 1.2
---
$id: http://devicetree.org/schemas/display/panel/openmoko,wikireader-lcd.yaml#
$schema: http://devicetree.org/meta-schemas/core.yaml#

title: Openmoko WikiReader panel

maintainers:
  - Tim Douglas <me@timdoug.com>

description:
  The WikiReader's 240x208 monochrome panel on the S1C33E07's LCD
  controller, with a display-enable line, and contrast that is a PWM's
  duty cycle.

allOf:
  - $ref: panel-common.yaml#

properties:
  compatible:
    const: openmoko,wikireader-lcd

  enable-gpios: true

  pwms:
    maxItems: 1
    description: The panel's bias, its contrast

  port: true

required:
  - compatible
  - enable-gpios
  - pwms
  - port

additionalProperties: false

examples:
  - |
    #include <dt-bindings/gpio/gpio.h>

    panel {
        compatible = "openmoko,wikireader-lcd";
        enable-gpios = <&pinctrl 24 GPIO_ACTIVE_HIGH>;
        pwms = <&pwm 0 68267 0>;

        port {
            endpoint {
                remote-endpoint = <&lcdc_out>;
            };
        };
    };
```

## linux/overlay/Documentation/devicetree/bindings/dma/epson,s1c33e07-hsdma.yaml
```yaml
# SPDX-License-Identifier: (GPL-2.0-only OR BSD-2-Clause)
%YAML 1.2
---
$id: http://devicetree.org/schemas/dma/epson,s1c33e07-hsdma.yaml#
$schema: http://devicetree.org/meta-schemas/core.yaml#

title: Epson S1C33E07 high-speed DMA controller

maintainers:
  - Tim Douglas <me@timdoug.com>

description:
  Four channels, each with triggers of its own, chosen in the interrupt
  controller's block.  Clients request a channel through the interrupt
  controller, the DMA router, which hands this controller the channel.
  Each channel's end-of-transfer interrupt is polled.

allOf:
  - $ref: dma-controller.yaml#

properties:
  compatible:
    const: epson,s1c33e07-hsdma

  reg:
    maxItems: 1

  interrupts:
    items:
      - description: Channel 0's end of transfer
      - description: Channel 1's end of transfer
      - description: Channel 2's end of transfer
      - description: Channel 3's end of transfer

  clocks:
    maxItems: 1

  '#dma-cells':
    const: 1
    description: The channel, 0 to 3.

required:
  - compatible
  - reg
  - interrupts
  - clocks
  - '#dma-cells'

unevaluatedProperties: false

examples:
  - |
    #include <dt-bindings/clock/epson,s1c33e07-cmu.h>

    dma-controller@301100 {
        compatible = "epson,s1c33e07-hsdma";
        reg = <0x301100 0xa0>;
        interrupts = <22 0>, <23 0>, <24 0>, <25 0>;
        clocks = <&cmu S1C33_CLK_HSDMA>;
        #dma-cells = <1>;
    };
```

## linux/overlay/Documentation/devicetree/bindings/iio/adc/epson,s1c33e07-adc.yaml
```yaml
# SPDX-License-Identifier: (GPL-2.0-only OR BSD-2-Clause)
%YAML 1.2
---
$id: http://devicetree.org/schemas/iio/adc/epson,s1c33e07-adc.yaml#
$schema: http://devicetree.org/meta-schemas/core.yaml#

title: Epson S1C33E07 analogue-to-digital converter

maintainers:
  - Tim Douglas <me@timdoug.com>

description:
  A 10-bit converter with eight inputs, AIN0 to AIN7, measured against the
  reference voltage.

properties:
  compatible:
    const: epson,s1c33e07-adc

  reg:
    maxItems: 1

  clocks:
    maxItems: 1

  vref-supply: true

  '#io-channel-cells':
    const: 1

required:
  - compatible
  - reg
  - clocks
  - vref-supply
  - '#io-channel-cells'

additionalProperties: false

examples:
  - |
    #include <dt-bindings/clock/epson,s1c33e07-cmu.h>

    adc@300520 {
        compatible = "epson,s1c33e07-adc";
        reg = <0x300520 0x40>;
        clocks = <&cmu S1C33_CLK_ADC>;
        vref-supply = <&avdd>;
        #io-channel-cells = <1>;
    };
```

## linux/overlay/Documentation/devicetree/bindings/input/touchscreen/openmoko,wikireader-touchscreen.yaml
```yaml
# SPDX-License-Identifier: (GPL-2.0-only OR BSD-2-Clause)
%YAML 1.2
---
$id: http://devicetree.org/schemas/input/touchscreen/openmoko,wikireader-touchscreen.yaml#
$schema: http://devicetree.org/meta-schemas/core.yaml#

title: Openmoko WikiReader touchscreen

maintainers:
  - Tim Douglas <me@timdoug.com>

description:
  The WikiReader's touchscreen controller, which sends reports over a
  serial line; a child of its serial port.

allOf:
  - $ref: touchscreen.yaml#
  - $ref: /schemas/serial/serial-peripheral-props.yaml#

properties:
  compatible:
    const: openmoko,wikireader-touchscreen

  reset-gpios:
    maxItems: 1

required:
  - compatible
  - current-speed

unevaluatedProperties: false

examples:
  - |
    #include <dt-bindings/gpio/gpio.h>

    serial {
        touchscreen {
            compatible = "openmoko,wikireader-touchscreen";
            reset-gpios = <&pinctrl 7 GPIO_ACTIVE_HIGH>;
            current-speed = <9600>;
            touchscreen-size-x = <240>;
            touchscreen-size-y = <208>;
        };
    };
```

## linux/overlay/Documentation/devicetree/bindings/interrupt-controller/epson,s1c33-itc.yaml
```yaml
# SPDX-License-Identifier: (GPL-2.0-only OR BSD-2-Clause)
%YAML 1.2
---
$id: http://devicetree.org/schemas/interrupt-controller/epson,s1c33-itc.yaml#
$schema: http://devicetree.org/meta-schemas/core.yaml#

title: Epson S1C33E07 interrupt controller

maintainers:
  - Tim Douglas <me@timdoug.com>

description:
  The S1C33E07's interrupt controller.  A source is its trap vector, and
  sources are grouped, each group with one priority level that the second
  cell sets.

properties:
  compatible:
    const: epson,s1c33-itc

  reg:
    maxItems: 1

  interrupt-controller: true

  '#interrupt-cells':
    const: 2
    description:
      The source's trap vector, and its group's priority, 1 (lowest) to 7.

required:
  - compatible
  - reg
  - interrupt-controller
  - '#interrupt-cells'

additionalProperties: false

examples:
  - |
    interrupt-controller@300260 {
        compatible = "epson,s1c33-itc";
        reg = <0x300260 0x40>;
        interrupt-controller;
        #interrupt-cells = <2>;
    };
```

## linux/overlay/Documentation/devicetree/bindings/interrupt-controller/epson,s1c33e07-itc.yaml
```yaml
# SPDX-License-Identifier: (GPL-2.0-only OR BSD-2-Clause)
%YAML 1.2
---
$id: http://devicetree.org/schemas/interrupt-controller/epson,s1c33e07-itc.yaml#
$schema: http://devicetree.org/meta-schemas/core.yaml#

title: Epson S1C33E07 interrupt controller

maintainers:
  - Tim Douglas <me@timdoug.com>

description:
  The S1C33E07's interrupt controller.  A source is its trap vector, and
  sources are grouped, each group with one priority level that the second
  cell sets.  Its block also selects each high-speed DMA channel's
  trigger, so it is the DMA router in front of that controller.

properties:
  compatible:
    const: epson,s1c33e07-itc

  reg:
    maxItems: 1

  interrupt-controller: true

  '#interrupt-cells':
    const: 2
    description:
      The source's trap vector, and its group's priority, 1 (lowest) to 7,
      or 0 to leave it as it is.

  '#dma-cells':
    const: 2
    description:
      The high-speed DMA channel, 0 to 3, and the trigger source that
      channel takes for the request, 0 to 15 (the manual's table II.1.5.1).

  dma-masters:
    maxItems: 1
    description: The high-speed DMA controller.

required:
  - compatible
  - reg
  - interrupt-controller
  - '#interrupt-cells'

dependentRequired:
  '#dma-cells': [ dma-masters ]

additionalProperties: false

examples:
  - |
    interrupt-controller@300260 {
        compatible = "epson,s1c33e07-itc";
        reg = <0x300260 0x50>;
        interrupt-controller;
        #interrupt-cells = <2>;
        #dma-cells = <2>;
        dma-masters = <&hsdma>;
    };
```
