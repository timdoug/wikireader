## linux/overlay/Documentation/devicetree/bindings/mmc/epson,s1c33e07-sd.yaml
```yaml
# SPDX-License-Identifier: (GPL-2.0-only OR BSD-2-Clause)
%YAML 1.2
---
$id: http://devicetree.org/schemas/mmc/epson,s1c33e07-sd.yaml#
$schema: http://devicetree.org/meta-schemas/core.yaml#

title: Epson S1C33E07 synchronous serial interface as an SD host

maintainers:
  - Tim Douglas <me@timdoug.com>

description:
  The synchronous serial interface run as an SD host in SPI mode, its
  transfers made by two DMA channels, with internal video RAM holding the
  all-ones the transmit channel sends while it receives.

allOf:
  - $ref: mmc-controller.yaml#

properties:
  compatible:
    const: epson,s1c33e07-sd

  reg:
    items:
      - description: The serial interface's registers
      - description: Internal RAM for the transmit stream

  reg-names:
    items:
      - const: spi
      - const: sram

  interrupts:
    items:
      - description: The receive DMA request, polled
      - description: The transmit DMA request, polled

  interrupt-names:
    items:
      - const: rx
      - const: tx

  clocks:
    maxItems: 1

  dmas:
    items:
      - description: Transmit
      - description: Receive

  dma-names:
    items:
      - const: tx
      - const: rx

  cs-gpios:
    maxItems: 1

  pinctrl-names:
    items:
      - const: default
      - const: hold
    description:
      The hold state parks the clock pin at its idle level while the
      interface restarts.

required:
  - compatible
  - reg
  - reg-names
  - interrupts
  - interrupt-names
  - clocks
  - dmas
  - dma-names
  - cs-gpios

unevaluatedProperties: false

examples:
  - |
    #include <dt-bindings/clock/epson,s1c33e07-cmu.h>
    #include <dt-bindings/gpio/gpio.h>

    mmc@301700 {
        compatible = "epson,s1c33e07-sd";
        reg = <0x301700 0x20>, <0x084000 0x200>;
        reg-names = "spi", "sram";
        interrupts = <81 0>, <82 0>;
        interrupt-names = "rx", "tx";
        clocks = <&cmu S1C33_CLK_SPI>;
        dmas = <&itc 2 9>, <&itc 3 9>;
        dma-names = "tx", "rx";
        cs-gpios = <&pinctrl 40 GPIO_ACTIVE_LOW>;
        vmmc-supply = <&sd_vcc>;
    };
```

## linux/overlay/Documentation/devicetree/bindings/pinctrl/epson,s1c33-pinctrl.yaml
```yaml
# SPDX-License-Identifier: (GPL-2.0-only OR BSD-2-Clause)
%YAML 1.2
---
$id: http://devicetree.org/schemas/pinctrl/epson,s1c33-pinctrl.yaml#
$schema: http://devicetree.org/meta-schemas/core.yaml#

title: Epson S1C33E07 pin controller and GPIO

maintainers:
  - Tim Douglas <me@timdoug.com>

description:
  The function select of ports 0 to 9 and the GPIOs of ports 0 to 6, a GPIO
  numbered port * 8 + bit.  Each pin is a group named for it ("P65"), and
  a peripheral's pins are a named group too, whose function has the same
  name.

properties:
  compatible:
    const: epson,s1c33-pinctrl

  reg:
    items:
      - description: The port data and direction registers
      - description: The function select registers
      - description: The port interrupt registers

  reg-names:
    items:
      - const: port
      - const: function
      - const: interrupt

  interrupts:
    items:
      - description: Key input 0
      - description: Port input 3

  interrupt-names:
    items:
      - const: key0
      - const: port3

  gpio-controller: true

  '#gpio-cells':
    const: 2

patternProperties:
  '-hog$':
    type: object
    required:
      - gpio-hog

  '-pins$':
    type: object
    $ref: pincfg-node.yaml#
    additionalProperties: false

    properties:
      groups:
        description: A named group, or pins as groups of their own
        items:
          pattern: '^(uart0|spi|adc|lcd|P[0-9][0-7])$'

      pins:
        items:
          pattern: '^P[0-9][0-7]$'

      function:
        description:
          The group's function, "gpio" for a pin's I/O port, or one of the
          signals the manual lists for the pin.
        pattern: '^[a-z0-9_]+$'

      output-low: true
      output-high: true

    required:
      - function

    oneOf:
      - required: [groups]
      - required: [pins]

required:
  - compatible
  - reg
  - reg-names
  - gpio-controller
  - '#gpio-cells'

additionalProperties: false

examples:
  - |
    #include <dt-bindings/gpio/gpio.h>

    pinctrl@300380 {
        compatible = "epson,s1c33-pinctrl";
        reg = <0x300380 0x0e>, <0x3003a0 0x14>, <0x3003c0 0x16>;
        reg-names = "port", "function", "interrupt";
        interrupts = <20 3>, <19 3>;
        interrupt-names = "key0", "port3";
        gpio-controller;
        #gpio-cells = <2>;

        flash-cs-hog {
            gpio-hog;
            gpios = <42 GPIO_ACTIVE_HIGH>;
            output-high;
        };

        sd-pins {
            groups = "spi";
            function = "spi";
        };

        sd-hold-pins {
            pins = "P67";
            function = "gpio";
            output-low;
        };
    };
```

## linux/overlay/Documentation/devicetree/bindings/pwm/epson,s1c33e07-pwm.yaml
```yaml
# SPDX-License-Identifier: (GPL-2.0-only OR BSD-2-Clause)
%YAML 1.2
---
$id: http://devicetree.org/schemas/pwm/epson,s1c33e07-pwm.yaml#
$schema: http://devicetree.org/meta-schemas/core.yaml#

title: Epson S1C33E07 16-bit timer as a PWM

maintainers:
  - Tim Douglas <me@timdoug.com>

description:
  One of the 16-bit timers driving its output pin as a PWM.

allOf:
  - $ref: pwm.yaml#

properties:
  compatible:
    const: epson,s1c33e07-pwm

  reg:
    items:
      - description: The timer's registers
      - description: The timer's clock control register

  reg-names:
    items:
      - const: timer
      - const: clock

  clocks:
    maxItems: 1

  '#pwm-cells':
    const: 3

required:
  - compatible
  - reg
  - reg-names
  - clocks

unevaluatedProperties: false

examples:
  - |
    #include <dt-bindings/clock/epson,s1c33e07-cmu.h>

    pwm@300788 {
        compatible = "epson,s1c33e07-pwm";
        reg = <0x300788 0x8>, <0x3007e2 0x2>;
        reg-names = "timer", "clock";
        clocks = <&cmu S1C33_CLK_TM1>;
        #pwm-cells = <3>;
    };
```

## linux/overlay/Documentation/devicetree/bindings/pwm/epson,s1c33e07-t16-pwm.yaml
```yaml
# SPDX-License-Identifier: (GPL-2.0-only OR BSD-2-Clause)
%YAML 1.2
---
$id: http://devicetree.org/schemas/pwm/epson,s1c33e07-t16-pwm.yaml#
$schema: http://devicetree.org/meta-schemas/core.yaml#

title: Epson S1C33E07 16-bit timer channel as a PWM

maintainers:
  - Tim Douglas <me@timdoug.com>

description:
  One channel of the 16-bit timer block driving its output pin as a PWM.
  A child of the block's node, epson,s1c33e07-t16, which owns the block's
  registers; reg is the channel.

allOf:
  - $ref: pwm.yaml#

properties:
  compatible:
    const: epson,s1c33e07-t16-pwm

  reg:
    description: The timer channel, one the block leaves to children.
    enum: [1, 4]

  clocks:
    maxItems: 1
    description: The channel's gate

  '#pwm-cells':
    const: 3

required:
  - compatible
  - reg
  - clocks

unevaluatedProperties: false

examples:
  - |
    #include <dt-bindings/clock/epson,s1c33e07-cmu.h>

    timer {
        #address-cells = <1>;
        #size-cells = <0>;

        pwm@1 {
            compatible = "epson,s1c33e07-t16-pwm";
            reg = <1>;
            clocks = <&cmu S1C33_CLK_TM1>;
            #pwm-cells = <3>;
        };
    };
```

## linux/overlay/Documentation/devicetree/bindings/serial/epson,s1c33-uart.yaml
```yaml
# SPDX-License-Identifier: (GPL-2.0-only OR BSD-2-Clause)
%YAML 1.2
---
$id: http://devicetree.org/schemas/serial/epson,s1c33-uart.yaml#
$schema: http://devicetree.org/meta-schemas/core.yaml#

title: Epson S1C33E07 serial interface in asynchronous mode

maintainers:
  - Tim Douglas <me@timdoug.com>

allOf:
  - $ref: serial.yaml#

properties:
  compatible:
    const: epson,s1c33-uart

  reg:
    maxItems: 1

  reg-names:
    const: uart

  interrupts:
    minItems: 1
    maxItems: 2

  interrupt-names:
    minItems: 1
    items:
      - enum: [rx, error]
      - const: rx

  clocks:
    maxItems: 1

  epson,rx-only:
    type: boolean
    description:
      The port only receives; its transmit pin is left to other uses.

  current-speed:
    $ref: /schemas/types.yaml#/definitions/uint32
    description: The line's speed, in bits a second

  wakeup-source: true

  touchscreen:
    type: object
    description: A touchscreen controller on the line, a serdev device

required:
  - compatible
  - reg
  - interrupts
  - interrupt-names
  - clocks
  - current-speed

unevaluatedProperties: false

examples:
  - |
    #include <dt-bindings/clock/s1c33-cmu.h>

    serial@300b00 {
        compatible = "epson,s1c33-uart";
        reg = <0x300b00 0x8>;
        reg-names = "uart";
        interrupts = <57 5>;
        interrupt-names = "rx";
        clocks = <&cmu S1C33_CLK_EFSIO>;
        current-speed = <115200>;
    };
```

## linux/overlay/Documentation/devicetree/bindings/spi/epson,s1c33e07-spi.yaml
```yaml
# SPDX-License-Identifier: (GPL-2.0-only OR BSD-2-Clause)
%YAML 1.2
---
$id: http://devicetree.org/schemas/spi/epson,s1c33e07-spi.yaml#
$schema: http://devicetree.org/meta-schemas/core.yaml#

title: Epson S1C33E07 synchronous serial interface as an SPI controller

maintainers:
  - Tim Douglas <me@timdoug.com>

description:
  The synchronous serial interface in SPI master mode.  Transfers of whole
  words go by two high-speed DMA channels, 32 bits a character; the port's
  DMA requests are interrupt causes, polled.  Changing the character size
  disables the port, so a hold pin state parks SCLK at its idle level
  across it.

allOf:
  - $ref: spi-controller.yaml#

properties:
  compatible:
    const: epson,s1c33e07-spi

  reg:
    maxItems: 1

  interrupts:
    items:
      - description: The receive DMA request, polled
      - description: The transmit DMA request, polled

  interrupt-names:
    items:
      - const: rx
      - const: tx

  clocks:
    maxItems: 1

  dmas:
    items:
      - description: Receive
      - description: Transmit

  dma-names:
    items:
      - const: rx
      - const: tx

  pinctrl-names:
    items:
      - const: default
      - const: hold

required:
  - compatible
  - reg
  - clocks

unevaluatedProperties: false

examples:
  - |
    #include <dt-bindings/clock/epson,s1c33e07-cmu.h>
    #include <dt-bindings/gpio/gpio.h>

    spi@301700 {
        compatible = "epson,s1c33e07-spi";
        reg = <0x301700 0x20>;
        interrupts = <81 0>, <82 0>;
        interrupt-names = "rx", "tx";
        clocks = <&cmu S1C33_CLK_SPI>;
        dmas = <&itc 3 9>, <&itc 2 9>;
        dma-names = "rx", "tx";
        cs-gpios = <&pinctrl 40 GPIO_ACTIVE_LOW>;
        #address-cells = <1>;
        #size-cells = <0>;

        mmc@0 {
            compatible = "mmc-spi-slot";
            reg = <0>;
            spi-max-frequency = <15000000>;
            voltage-ranges = <3200 3400>;
        };
    };
```
