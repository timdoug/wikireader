## linux/overlay/Documentation/devicetree/bindings/timer/epson,s1c33-t16.yaml
```yaml
# SPDX-License-Identifier: (GPL-2.0-only OR BSD-2-Clause)
%YAML 1.2
---
$id: http://devicetree.org/schemas/timer/epson,s1c33-t16.yaml#
$schema: http://devicetree.org/meta-schemas/core.yaml#

title: Epson S1C33E07 16-bit timer block

maintainers:
  - Tim Douglas <me@timdoug.com>

description:
  Six 16-bit timers.  Timer 0 counts MCLK and its output clocks timer 5
  through the board's wiring of TM0 (P10) to EXCL5 (P74), so the two read
  as one 32-bit counter; timer 2 is the clock event and timer 3 a slow wake
  from suspend.  The default pin state selects those two functions.

properties:
  compatible:
    const: epson,s1c33-t16

  reg:
    maxItems: 1

  interrupts:
    items:
      - description: Timer 2's compare A, the clock event
      - description: Timer 3's compare A, the suspend wake

  clocks:
    items:
      - description: MCLK, which the timers count
      - description: Timer 0's gate
      - description: Timer 2's gate
      - description: Timer 3's gate
      - description: Timer 5's gate

  clock-names:
    items:
      - const: mclk
      - const: tm0
      - const: tm2
      - const: tm3
      - const: tm5

  pinctrl-names:
    const: default

  pinctrl-0:
    description: TM0 out and EXCL5 in, which carry the cascade

required:
  - compatible
  - reg
  - interrupts
  - clocks
  - clock-names
  - pinctrl-names
  - pinctrl-0

additionalProperties: false

examples:
  - |
    #include <dt-bindings/clock/s1c33-cmu.h>

    timer@300780 {
        compatible = "epson,s1c33-t16";
        reg = <0x300780 0x80>;
        interrupts = <38 4>, <42 4>;
        clocks = <&cmu S1C33_CLK_MCLK>, <&cmu S1C33_CLK_TM0>,
                 <&cmu S1C33_CLK_TM2>, <&cmu S1C33_CLK_TM3>,
                 <&cmu S1C33_CLK_TM5>;
        clock-names = "mclk", "tm0", "tm2", "tm3", "tm5";
        pinctrl-names = "default";
        pinctrl-0 = <&timer_tm0_pins>, <&timer_excl5_pins>;
    };
```

## linux/overlay/Documentation/devicetree/bindings/watchdog/epson,s1c33e07-wdt.yaml
```yaml
# SPDX-License-Identifier: (GPL-2.0-only OR BSD-2-Clause)
%YAML 1.2
---
$id: http://devicetree.org/schemas/watchdog/epson,s1c33e07-wdt.yaml#
$schema: http://devicetree.org/meta-schemas/core.yaml#

title: Epson S1C33E07 watchdog timer

maintainers:
  - Tim Douglas <me@timdoug.com>

allOf:
  - $ref: watchdog.yaml#

properties:
  compatible:
    const: epson,s1c33e07-wdt

  reg:
    maxItems: 1

  clocks:
    maxItems: 1

required:
  - compatible
  - reg
  - clocks

unevaluatedProperties: false

examples:
  - |
    #include <dt-bindings/clock/epson,s1c33e07-cmu.h>

    watchdog@300660 {
        compatible = "epson,s1c33e07-wdt";
        reg = <0x300660 0x10>;
        clocks = <&cmu S1C33_CLK_WDT>;
    };
```

## linux/overlay/arch/c33/Kconfig
```kconfig
# SPDX-License-Identifier: GPL-2.0-only
config C33
	bool
	default y
	select ARCH_32BIT_OFF_T
	select ARCH_HAS_BINFMT_FLAT
	select ARCH_NO_PREEMPT
	select ARCH_NO_SWAP
	select BINFMT_FLAT_ARGVP_ENVP_ON_STACK
	select CPU_NO_EFFICIENT_FFS
	select GENERIC_ATOMIC64
	select GENERIC_CPU_DEVICES
	select GENERIC_IRQ_SHOW
	select GENERIC_LIB_ASHLDI3
	select GENERIC_LIB_ASHRDI3
	select GENERIC_LIB_LSHRDI3
	select GENERIC_LIB_MULDI3
	select HAVE_PAGE_SIZE_4KB
	select HAVE_UID16
	select LEGACY_TIMER_TICK
	select NO_DMA
	select THREAD_INFO_IN_TASK
	select UACCESS_MEMCPY

config CPU_LITTLE_ENDIAN
	def_bool y

config GENERIC_CSUM
	def_bool y

config GENERIC_CALIBRATE_DELAY
	def_bool y

config GENERIC_HWEIGHT
	def_bool y

config NO_IOPORT_MAP
	def_bool y

config MMU
	def_bool n

config NR_CPUS
	int
	default 1

config HZ
	int
	default 100

menu "C33 platform options"

config C33_WIKIREADER
	bool "Openmoko WikiReader"
	default y
	help
	  Build for the S1C33E07 WikiReader with 32 MiB of SDRAM.

config PHYSICAL_START
	hex "SDRAM base"
	default 0x10000000

config C33_KERNEL_START
	hex "Kernel load address"
	default 0x10040000
	help
	  The FLASH-resident file loader remains below this address and loads the
	  ELF image here.

config C33_MEMORY_SIZE
	hex "SDRAM size"
	default 0x02000000

config CMDLINE
	string "Built-in kernel command line"
	default "console=ttyC330,115200"

endmenu

source "kernel/Kconfig.hz"
```

## linux/overlay/arch/c33/Kconfig.debug
```kconfig
# SPDX-License-Identifier: GPL-2.0-only

config C33_IRAM_BENCH
	bool "Benchmark internal RAM against SDRAM"
	help
	  Times the same loops, string routines and divisions from SDRAM
	  and from A0 RAM, to check wremu's model of both against the
	  device:

	    echo 1 > /sys/module/iram_bench/parameters/run

	  prints one line a case to the kernel log.  It needs about 700
	  bytes of A0 RAM free.  If unsure, say N.
```

## linux/overlay/arch/c33/configs/wikireader_defconfig
```kconfig
CONFIG_DEFAULT_HOSTNAME="wikireader"
CONFIG_SYSVIPC=y
CONFIG_POSIX_MQUEUE=y
CONFIG_NO_HZ_IDLE=y
CONFIG_HIGH_RES_TIMERS=y
CONFIG_LOG_BUF_SHIFT=13
CONFIG_BLK_DEV_INITRD=y
# CONFIG_RD_GZIP is not set
# CONFIG_RD_BZIP2 is not set
# CONFIG_RD_LZMA is not set
# CONFIG_RD_XZ is not set
# CONFIG_RD_LZO is not set
# CONFIG_RD_LZ4 is not set
# CONFIG_RD_ZSTD is not set
CONFIG_LD_DEAD_CODE_DATA_ELIMINATION=y
CONFIG_EXPERT=y
# CONFIG_AIO is not set
# CONFIG_IO_URING is not set
# CONFIG_KALLSYMS is not set
CONFIG_HZ_100=y
# CONFIG_COMPAT_32BIT_TIME is not set
# CONFIG_MQ_IOSCHED_DEADLINE is not set
# CONFIG_MQ_IOSCHED_KYBER is not set
# CONFIG_IOSCHED_BFQ is not set
CONFIG_SLUB_TINY=y
CONFIG_MEMFD_CREATE=y
CONFIG_NET=y
CONFIG_UNIX=y
# CONFIG_AF_UNIX_OOB is not set
# CONFIG_WIRELESS is not set
# CONFIG_ETHTOOL_NETLINK is not set
CONFIG_DEVTMPFS=y
CONFIG_BLK_DEV_LOOP=y
CONFIG_BLK_DEV_LOOP_MIN_COUNT=1
CONFIG_INPUT_EVDEV=y
CONFIG_KEYBOARD_GPIO=y
# CONFIG_INPUT_MOUSE is not set
CONFIG_INPUT_TOUCHSCREEN=y
CONFIG_TOUCHSCREEN_WIKIREADER=y
CONFIG_INPUT_MISC=y
CONFIG_INPUT_UINPUT=y
# CONFIG_CONSOLE_TRANSLATIONS is not set
# CONFIG_VT_CONSOLE is not set
# CONFIG_LEGACY_PTYS is not set
CONFIG_SERIAL_S1C33=y
CONFIG_SERIAL_S1C33_CONSOLE=y
# CONFIG_HW_RANDOM is not set
CONFIG_PINCTRL=y
CONFIG_PINCTRL_S1C33=y
CONFIG_POWER_SUPPLY=y
# CONFIG_POWER_SUPPLY_HWMON is not set
CONFIG_GENERIC_ADC_BATTERY=y
CONFIG_SENSORS_NTC_THERMISTOR=y
CONFIG_WATCHDOG=y
CONFIG_S1C33_WATCHDOG=y
CONFIG_REGULATOR=y
CONFIG_REGULATOR_FIXED_VOLTAGE=y
CONFIG_DRM=y
CONFIG_DRM_PANIC=y
CONFIG_DRM_CLIENT_LOG=y
CONFIG_DRM_PANEL_WIKIREADER=y
CONFIG_DRM_S1C33_LCDC=y
# CONFIG_HID is not set
# CONFIG_USB_SUPPORT is not set
CONFIG_MMC=y
CONFIG_MMC_S1C33_SD=y
CONFIG_DMADEVICES=y
CONFIG_S1C33_HSDMA=y
CONFIG_IIO=y
CONFIG_S1C33_ADC=y
CONFIG_IIO_RESCALE=y
CONFIG_PWM=y
CONFIG_PWM_S1C33=y
CONFIG_EXT4_FS=y
CONFIG_VFAT_FS=y
CONFIG_NLS_CODEPAGE_437=y
CONFIG_NLS_ISO8859_1=y
CONFIG_INIT_STACK_NONE=y
CONFIG_CONSOLE_LOGLEVEL_DEFAULT=4
CONFIG_VMLINUX_MAP=y
```

## nuttx/overlay/apps/interpreters/micropython/Kconfig
```kconfig
#
# For a description of the syntax of this configuration file,
# see the file kconfig-language.txt in the NuttX tools repository.
#

config INTERPRETERS_MICROPYTHON
	bool "MicroPython"
	default n
	select ARCH_SETJMP_H
	select LIBC_FLOATINGPOINT
	---help---
		Python, in the amount that fits.  The compiler, the bytecode
		virtual machine and the garbage collector all build for this
		architecture without a line of assembly: the non-local return and
		the register spill that the collector needs both fall back to
		setjmp, which this architecture has.

		There is no native code emitter for the C33 and none is wanted;
		everything runs as bytecode.  Floats are single precision, this
		chip having no floating-point unit at all.

		The source is fetched at build time, which needs a network and
		python3.

if INTERPRETERS_MICROPYTHON

config INTERPRETERS_MICROPYTHON_VERSION
	string "MicroPython version"
	default "1.29.0"

config INTERPRETERS_MICROPYTHON_HEAPSIZE
	int "Garbage-collected heap"
	default 262144
	---help---
		Bytes the collector is given to work in, taken from the system
		heap when the interpreter starts and returned when it stops.
		Everything a program allocates comes out of this.

config INTERPRETERS_MICROPYTHON_STACKSIZE
	int "Task stack size"
	default 32768
	---help---
		The interpreter recurses through the parser and the compiler, and
		checks this figure against its own stack use to raise a Python
		exception rather than run off the end.

config INTERPRETERS_MICROPYTHON_PRIORITY
	int "Task priority"
	default 100

endif # INTERPRETERS_MICROPYTHON
```

## nuttx/overlay/apps/interpreters/tinycc/Kconfig
```kconfig
# SPDX-License-Identifier: LGPL-2.0-or-later
config INTERPRETERS_TCC
	bool "TinyCC C33 compiler (experimental)"
	default n
	depends on ARCH_C33 && BUILD_FLAT && LIBC_MAX_EXITFUNS > 0
	select LIBC_FLOATINGPOINT
	select FS_TMPFS
	---help---
		Compile and run native C33 C programs from NSH. Builds against
		a TinyCC checkout carrying the C33 backend; see
		INTERPRETERS_TCC_SRCDIR. Supports integer C, software floating
		point, and compiling TinyCC itself from the bundled sources.
		No inline assembly.

if INTERPRETERS_TCC

config INTERPRETERS_TCC_SRCDIR
	string "TinyCC source directory"
	default "../tinycc"
	---help---
		Location of the TinyCC checkout providing the compiler sources
		and the C33 backend (c33-gen.c, c33-link.c, c33-run.c). A
		relative path is resolved from the apps directory, so the
		default expects the checkout beside it in the NuttX root.

endif # INTERPRETERS_TCC
```

## nuttx/overlay/apps/interpreters/wrforth/Kconfig
```kconfig
#
# For a description of the syntax of this configuration file,
# see the file kconfig-language.txt in the NuttX tools repository.
#

config INTERPRETERS_WRFORTH
	bool "WikiReader Forth"
	default n
	---help---
		The ANS Forth the WikiReader shipped with, running as a task.

		It is metacompiled from samo-lib/forth by gforth at build time,
		which has to be on the path; awk does the rest and any awk will
		do.  Everything it knows
		about the outside world it reaches through about sixty C calls,
		and those are answered here with POSIX file and terminal calls
		instead of the bare-metal drivers, so "include /sd/calc.4th"
		loads the same program the device has always run.

		The two Forth stacks are its own, not the task's, so only one
		instance can run at a time.

if INTERPRETERS_WRFORTH

config INTERPRETERS_WRFORTH_SRCDIR
	string "WikiReader Forth source directory"
	default "../../../../../../samo-lib/forth"
	---help---
		Where ansi-forth.fs and its assembly live, relative to this
		application's own directory.  The default climbs back out of the
		reconstructed work tree to the copy this repository carries.

config INTERPRETERS_WRFORTH_DICTSIZE
	int "Dictionary size"
	default 262144
	---help---
		Bytes reserved for the dictionary to grow into.  On the metal it
		simply continued into whatever SDRAM was left; here it gets a
		section of its own, fixed at link time.  Nothing checks the limit,
		so leave room.

config INTERPRETERS_WRFORTH_PRIORITY
	int "Task priority"
	default 100

config INTERPRETERS_WRFORTH_STACKSIZE
	int "Task stack size"
	default 4096
	---help---
		Only used up to the point the interpreter switches to its own
		return stack, which is a fixed 64 KB inside the image.

endif # INTERPRETERS_WRFORTH
```

## nuttx/overlay/apps/system/bench/Kconfig
```kconfig
#
# For a description of the syntax of this configuration file,
# see the file kconfig-language.txt in the NuttX tools repository.
#

config SYSTEM_BENCH
	tristate "Run the benchmarks and save the results"
	default n
	depends on BUILTIN && SCHED_WAITPID && NSH_PIPELINE
	---help---
		NSH_PIPELINE is what makes the builtin spawn able to hand a child a
		descriptor rather than a path, and a shared descriptor is the only
		way several programs can write one file on a FAT card in order.
	---help---
		One command that runs every benchmark in the image and writes what
		they printed to a file, so that a device with no network and a
		keyboard you would not wish on anybody can be measured by typing
		five letters and then taking the card out.

if SYSTEM_BENCH

config SYSTEM_BENCH_PROGNAME
	string "Program name"
	default "bench"

config SYSTEM_BENCH_PRIORITY
	int "Task priority"
	default 100

config SYSTEM_BENCH_STACKSIZE
	int "Stack size"
	default 2048

config SYSTEM_BENCH_OUTPUT
	string "Where the results go"
	default "/sd/bench.txt"
	---help---
		Overridden by an argument.

config SYSTEM_BENCH_MOUNT
	string "Filesystem to unmount when finished"
	default "/sd"
	---help---
		Unmounted once the results are written, so that the card can be
		taken out as soon as the command says it is safe to.

endif
```

## nuttx/overlay/nuttx/arch/c33/Kconfig
```kconfig
choice
	prompt "C33 chip"
	default ARCH_CHIP_S1C33E07

config ARCH_CHIP_S1C33E07
	bool "S1C33E07 (C33 PE)"

endchoice

config ARCH_CHIP
	string
	default "s1c33e07"

config RAM_START
	default 0x10000000

config RAM_SIZE
	default 33554432

config S1C33E07_UART0
	bool
	default y
	select UART0_SERIALDRIVER

config S1C33E07_MCLK
	int "Main clock frequency"
	default 60000000
	---help---
		What the loader leaves running, not the crystal.  The 48 MHz
		crystal goes into the PLL divided by 8 and comes out at 60 MHz,
		and that is the system clock by the time an application is
		loaded -- grifo's own comment on the setup says so, the
		original firmware computes the touch panel's baud rate from it
		(samo-lib/drivers/src/ctp.c), and the emulator derives the same
		figure from the registers (emulator/tools/test_cmu.c, "system
		clock is 60 MHz").

		This port read 48 MHz here for a long time, which made the
		system tick a quarter fast, every udelay a quarter short, the
		SPI clock a quarter high and both serial ports unusable.
```
