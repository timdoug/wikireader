## nuttx/overlay/nuttx/boards/c33/s1c33e07/wikireader/Kconfig
```kconfig
# SPDX-License-Identifier: Apache-2.0

config WIKIREADER_GRIFO_APP
	bool "Run as a Grifo application"
	select ARCH_HAVE_POWEROFF
	select ARCH_HAVE_RESET
	select BOARDCTL
	select BOARDCTL_POWEROFF
	select BOARDCTL_RESET
	---help---
		Build for the WikiReader's resident kernel to load off an SD card
		and jump to, alongside the ZIM reader and DOOM, rather than for a
		loader that is finished with the machine.

		The kernel stays resident below 0x10040000, so CONFIG_RAM_START
		must leave that alone.  It is what NSH's "poweroff" and "reboot"
		then call to cut power or reset the device.

		This says nothing about how the card is read at run time -- it
		is not, yet.  Only the kernel's loader touches it, before NuttX
		is entered.

config WIKIREADER_SDCARD
	bool "WikiReader SD card over SPI"
	select SPI
	select SPI_EXCHANGE
	select MMCSD
	select MMCSD_SPI
	select FS_FAT
	select MBR_PARTITION
	---help---
		Drive the card slot from NuttX rather than leaving it to the boot
		loader: the chip's one SPI master, the card's power rail and
		buffer on port 3, and the chip select on P50.

		The card is partitioned, so the table is read and each partition
		registered as /dev/mmcsd0N.  Only the first is mounted, and only
		as FAT -- the second volume on a stock WikiReader card is exFAT,
		which this cannot read.

config WIKIREADER_SDCARD_MOUNT
	string "SD card mount point"
	default "/sd"
	depends on WIKIREADER_SDCARD

config WIKIREADER_LCD
	bool "WikiReader monochrome framebuffer"
	select DRIVERS_VIDEO
	select VIDEO_FB
	---help---
		240x208 LCD in 1-bpp mode, with a 32-byte stride in internal VRAM.
		The boot loader supplies the panel's contrast/power-rail setup.

config WIKIREADER_BOOT_PROGRESS
	bool "Draw startup progress on the panel"
	default y
	depends on WIKIREADER_LCD
	---help---
		One square along the top of the display per stage of board
		startup, drawn before there is a terminal to print to.  A device
		with nothing attached to its serial port has no other way to say
		how far it got, and the terminal paints over them when it starts.

config WIKIREADER_TOUCH
	bool "WikiReader UART1 touchscreen"
	select INPUT
	select INPUT_TOUCHSCREEN
	---help---
		Decode the panel's 9600-baud coordinate packets as /dev/input0.

config WIKIREADER_TERMINAL
	bool "WikiReader NSH terminal and touch keyboard"
	depends on WIKIREADER_LCD && WIKIREADER_TOUCH
	depends on NXTERM && PSEUDOTERM && SYSTEM_NSH
	depends on NSH_CONSOLE && NSH_READLINE && SCHED_WAITPID
	depends on TTY_SIGINT && READLINE_EDIT_EMACS && SIG_SIGKILL_ACTION
	depends on NX_BLOCKING && !NX_DISABLE_1BPP && !NXFONTS_DISABLE_1BPP
	depends on NXFONT_X11_MISC_FIXED_6X9 && NXTERM_BPP = 1
	---help---
		Use wikireader_main as the init entry point.  Runs NSH through a
		pseudo-terminal with NXTerm output and an on-screen keyboard.
```

## nuttx/overlay/nuttx/libs/libc/machine/c33/Kconfig
```kconfig
#
# For a description of the syntax of this configuration file,
# see the file kconfig-language.txt in the NuttX tools repository.
#

config C33_STRING_FUNCTION
	bool "Enable optimized C33 specific string function"
	default n
	select C33_MEMCPY
	select C33_MEMCMP
	select C33_MEMMOVE
	select C33_MEMSET
	select C33_STRLEN
	---help---
		The generic implementations move one byte per pass, which the C33
		spends five instructions on. These use word accesses with the
		post-incrementing addressing mode instead.

config C33_MEMCPY
	bool "Enable optimized memcpy() for C33"
	select LIBC_ARCH_MEMCPY
	---help---
		Enable optimized C33 specific memcpy() library function

config C33_MEMCMP
	bool "Enable optimized memcmp() for C33"
	select LIBC_ARCH_MEMCMP
	---help---
		Enable optimized C33 specific memcmp() library function

config C33_MEMMOVE
	bool "Enable optimized memmove() for C33"
	select LIBC_ARCH_MEMMOVE
	select C33_MEMCPY
	---help---
		Enable optimized C33 specific memmove() library function. It tail
		calls memcpy() for the non-overlapping direction.

config C33_MEMSET
	bool "Enable optimized memset() for C33"
	select LIBC_ARCH_MEMSET
	---help---
		Enable optimized C33 specific memset() library function

config C33_STRLEN
	bool "Enable optimized strlen() for C33"
	select LIBC_ARCH_STRLEN
	---help---
		Enable optimized C33 specific strlen() library function
```
